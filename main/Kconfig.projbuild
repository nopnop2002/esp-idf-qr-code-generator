## main/Kconfig.projbuild
```kconfig
menu "Application configuration"

	menu "WiFi Setting"

		config ESP_WIFI_SSID
			string "WiFi SSID"
			default "myssid"
			help
				SSID (network name) to connect to.

		config ESP_WIFI_PASSWORD
			string "WiFi Password"
			default "mypassword"
			help
				WiFi password (WPA or WPA2) to connect to.

		config ESP_MAXIMUM_RETRY
			int "Maximum retry"
			default 5
			help
				Set the Maximum retry to avoid station reconnecting to the AP unlimited when the AP is really inexistent.

		config MDNS_HOSTNAME
			string "mDNS Hostname"
			default "esp32"
			help
				The mDNS host name used by the ESP32.

	endmenu

	menu "HTTP Server Setting"

		config WEB_PORT
			int "HTTP Server Port"
			default 8000
			help
				HTTP server port to use.

	endmenu

endmenu
```
